// device-measurements WO1 - image B2: M1 (the real frame loop) then M3 (blocked-loop
// repaint). Test firmware, not product code. The frame sequence is the runtime's own
// ui_handler(); nothing here re-implements it.
//
// Screen (ui/screens/screen_measure.xml, generated by this worktree's CLI):
//   ticker  scroll_circular label, 40 px/s, initial delay 1000 ms  (obj index 0)
//   clock   HH:MM:SS clock, blink on, bound to a time subject      (obj index 1)
//   caption static label                                           (obj index 2)
// The application writes the clock's time subject once per loop pass (epoch = 12:34:56 at
// boot + millis()/1000), as a real app would; the clock widget promises no deadline for
// second boundaries, only for its colon blink.
//
// M1 phase U (20 s): ui_handler() back-to-back.
// M1 phase D (20 s): d = ui_handler(); delay(min(d, 1000)).
// M3 phase  (10 s): app state set to something non-framework, no ui_handler(); every 500 ms
//   set the time subject, u8g2gl_repaint_object(clock), compare state + buffer outside the
//   clock's bounds, then u8g2gl_partial_refresh() of the clock bounds (the caller's push).
//
// "sent" = the call took > kSendThresholdUs. A full sendBuffer() is ~ms on this bus and a
// call without one is ~tens of us; the summary prints min_send_us and max_nosend_us so the
// separation is checkable, and flags overlap. "changed" = the 2048-byte buffer differs from
// the copy taken after the previous call. Reads of the label's scroll offset use a
// private-as-public include of u8g2gl_label.h in THIS file only (no runtime edit).
//
// Serial 115200 (USB CDC on boot), key=value, tags "U8G2GL-M1 " and "U8G2GL-M3 ". After the
// run both summaries are reprinted every 5 s, each ending "... end".

#include "ui.hpp"  // Generated; first, so its capacities precede u8g2gl_config.h

#include <Arduino.h>
#include <SPI.h>
#include <U8g2lib.h>
#include <esp_timer.h>
#include <string.h>

#include "u8g2gl/u8g2gl_clock.h"
#include "u8g2gl/u8g2gl_core.h"
#include "u8g2gl/u8g2gl_helpers.h"
#include "u8g2gl/u8g2gl_version.h"

#define private public
#include "u8g2gl/u8g2gl_label.h"
#undef private

static constexpr int kPinCs = 10;
static constexpr int kPinDc = 9;
static constexpr int kPinSck = 48;
static constexpr int kPinMiso = 47;
static constexpr int kPinMosi = 38;

static U8G2_SSD1322_NHD_256X64_F_4W_HW_SPI display(U8G2_R0, kPinCs, kPinDc, U8X8_PIN_NONE);

static constexpr uint32_t kPhaseUMs = 20000;
static constexpr uint32_t kPhaseDMs = 20000;
static constexpr uint32_t kPhaseM3Ms = 10000;
static constexpr uint32_t kSendThresholdUs = 2000;
static constexpr uint32_t kDeadlineCapMs = 1000;
static constexpr uint32_t kBaseEpoch = 12u * 3600u + 34u * 60u + 56u;
static constexpr size_t kBufBytes = 2048;

static u8g2gl_label* s_ticker = nullptr;
static u8g2gl_clock* s_clock = nullptr;

static uint8_t s_prev[kBufBytes];

static uint32_t tickNow() { return static_cast<uint32_t>(millis()); }
static uint32_t epochNow() { return kBaseEpoch + millis() / 1000u; }

// ---------------------------------------------------------------- phase statistics

enum { kBuckets = 11 };
static const char* const kBucketName[kBuckets] = {"0",     "1_4",    "5_9",     "10_14",
                                                  "15_19", "20_24",  "25",      "26_99",
                                                  "100_499", "500_plus", "idle"};
static int bucketOf(uint32_t d) {
    if (d == U8G2GL_IDLE) return 10;
    if (d == 0) return 0;
    if (d < 5) return 1;
    if (d < 10) return 2;
    if (d < 15) return 3;
    if (d < 20) return 4;
    if (d < 25) return 5;
    if (d == 25) return 6;
    if (d < 100) return 7;
    if (d < 500) return 8;
    return 9;
}

struct Phase {
    uint32_t duration_ms = 0;
    uint32_t calls = 0, sent = 0, changed = 0, wasted = 0;  // wasted = sent && !changed
    uint64_t sum_send_us = 0, sum_nosend_us = 0;
    uint32_t min_send_us = 0xFFFFFFFFu, max_send_us = 0, max_nosend_us = 0;
    uint32_t hist[kBuckets] = {0};
    // phase D only
    uint32_t cap_hits = 0, idle_returns = 0;
    uint32_t wake_early = 0, wake_ontime = 0, wake_late = 0;   // t_start vs promise, +-1 ms
    uint32_t late_1_5 = 0, late_5_10 = 0, late_gt10 = 0;
    int32_t max_late_us = INT32_MIN;
    int32_t min_early_us = INT32_MAX;                          // most negative lateness
    uint64_t sum_appear_us = 0; uint32_t max_appear_us = 0; uint32_t appear_n = 0;
    uint32_t nochange_nosend = 0;                              // woken, nothing dirty
    // scroll / clock content
    uint32_t scroll_steps = 0, scroll_wraps = 0, scroll_jumps = 0, scroll_back = 0;
    uint32_t clock_changes = 0, clock_skips = 0;
    uint32_t clock_lat_n = 0, clock_lat_max_ms = 0; uint64_t clock_lat_sum_ms = 0;
    uint32_t colon_toggles = 0;
};
static Phase s_u, s_d;
static const char* s_runtime_str = "";

// One ui_handler() call plus its bookkeeping. Returns the deadline. Nothing printed.
// `t_start_us`/`t_ret_us` are esp_timer stamps taken immediately around the call.
static uint32_t timedCall(Phase& p, int64_t& t_start_us, int64_t& t_ret_us, bool& changed) {
    const int16_t scroll_before = s_ticker->scroll_x_;
    const bool colon_before = s_clock->is_colon_visible();
    t_start_us = esp_timer_get_time();
    const uint32_t d = ui_handler(display);
    t_ret_us = esp_timer_get_time();
    const uint32_t us = static_cast<uint32_t>(t_ret_us - t_start_us);

    const bool sent = us > kSendThresholdUs;
    const uint8_t* buf = display.getBufferPtr();
    changed = memcmp(buf, s_prev, kBufBytes) != 0;
    if (changed) memcpy(s_prev, buf, kBufBytes);

    p.calls++;
    if (sent) {
        p.sent++;
        p.sum_send_us += us;
        if (us < p.min_send_us) p.min_send_us = us;
        if (us > p.max_send_us) p.max_send_us = us;
        if (!changed) p.wasted++;
    } else {
        p.sum_nosend_us += us;
        if (us > p.max_nosend_us) p.max_nosend_us = us;
    }
    if (changed) p.changed++;
    p.hist[bucketOf(d)]++;

    // Content steps: the ticker advances one pixel per tick, wraps to -width.
    const int16_t step = static_cast<int16_t>(s_ticker->scroll_x_ - scroll_before);
    if (step == 1) {
        p.scroll_steps++;
    } else if (step != 0) {
        if (s_ticker->scroll_x_ == static_cast<int16_t>(-s_ticker->get_w())) p.scroll_wraps++;
        else if (step < 0) p.scroll_back++;
        else p.scroll_jumps++;  // advanced by more than one pixel in one call
    }
    if (s_clock->is_colon_visible() != colon_before) p.colon_toggles++;
    return d;
}

// Write the clock subject from the wall clock; track second-to-second jumps.
static uint32_t s_last_epoch_written = 0;
static void feedClock(Phase& p) {
    const uint32_t e = epochNow();
    if (e != s_last_epoch_written) {
        const uint32_t late = millis() % 1000u;  // ms past the second boundary at write time
        if (s_last_epoch_written != 0) {
            p.clock_changes++;
            if (e - s_last_epoch_written > 1) p.clock_skips++;
            p.clock_lat_n++;
            p.clock_lat_sum_ms += late;
            if (late > p.clock_lat_max_ms) p.clock_lat_max_ms = late;
        }
        s_last_epoch_written = e;
        ui_subject_clock_time.set(e);
    }
}

static void runPhaseU() {
    Phase& p = s_u;
    p.duration_ms = kPhaseUMs;
    const uint32_t start = millis();
    int64_t t0, t1;
    bool changed;
    while (millis() - start < kPhaseUMs) {
        feedClock(p);
        timedCall(p, t0, t1, changed);
    }
}

static void runPhaseD() {
    Phase& p = s_d;
    p.duration_ms = kPhaseDMs;
    const uint32_t start = millis();
    int64_t t0, t1, prev_due_us = 0;
    bool changed, have_prev = false;
    while (millis() - start < kPhaseDMs) {
        feedClock(p);
        const uint32_t d = timedCall(p, t0, t1, changed);
        if (have_prev) {
            const int32_t late_us = static_cast<int32_t>(t0 - prev_due_us);
            if (late_us > p.max_late_us) p.max_late_us = late_us;
            if (late_us < p.min_early_us) p.min_early_us = late_us;
            if (late_us < -1000) p.wake_early++;
            else if (late_us <= 1000) p.wake_ontime++;
            else {
                p.wake_late++;
                if (late_us <= 5000) p.late_1_5++;
                else if (late_us <= 10000) p.late_5_10++;
                else p.late_gt10++;
            }
            if (changed) {
                const uint32_t appear = static_cast<uint32_t>(t1 - prev_due_us);
                p.sum_appear_us += appear;
                p.appear_n++;
                if (appear > p.max_appear_us) p.max_appear_us = appear;
            }
        }
        if (d == U8G2GL_IDLE) p.idle_returns++;
        const uint32_t wait = (d == U8G2GL_IDLE || d > kDeadlineCapMs) ? kDeadlineCapMs : d;
        if (wait != d) p.cap_hits++;
        if (!changed && p.calls > 0 && (t1 - t0) <= static_cast<int64_t>(kSendThresholdUs)) p.nochange_nosend++;
        prev_due_us = t1 + static_cast<int64_t>(wait) * 1000;
        have_prev = true;
        delay(wait);
    }
}

// ---------------------------------------------------------------- M3

struct Snap {
    const uint8_t* font;
    void* vref;
    uint8_t draw_color, font_mode, bitmap_mode, height_mode;
    uint8_t clip_x0, clip_y0, clip_x1, clip_y1;
};
static Snap takeSnap() {
    u8g2_t* s = display.getU8g2();
    Snap k;
    k.font = s->font;
    k.vref = reinterpret_cast<void*>(s->font_calc_vref);
    k.draw_color = s->draw_color;
    k.font_mode = s->font_decode.is_transparent;
    k.bitmap_mode = s->bitmap_transparency;
    k.height_mode = s->font_height_mode;
    k.clip_x0 = s->clip_x0; k.clip_y0 = s->clip_y0; k.clip_x1 = s->clip_x1; k.clip_y1 = s->clip_y1;
    return k;
}

struct M3 {
    uint32_t repaints = 0, true_returns = 0, false_returns = 0;
    uint32_t mis_font = 0, mis_vref = 0, mis_draw_color = 0, mis_font_mode = 0, mis_bitmap_mode = 0,
             mis_height_mode = 0, mis_clip = 0, mis_any = 0;
    uint32_t oob_change_calls = 0, oob_bytes_changed = 0;
    uint32_t in_bounds_changed = 0;       // repaints that changed pixels inside the bounds
    uint32_t repaint_us_min = 0xFFFFFFFFu, repaint_us_max = 0; uint64_t repaint_us_sum = 0;
    int bx = 0, by = 0, bw = 0, bh = 0;
    // after resume
    uint32_t resume_calls = 0, resume_changed = 0, resume_first_changed = 0, resume_sent = 0;
    uint32_t resume_state_mis = 0;
    uint32_t duration_ms = 0;
};
static M3 s_m3;

// Bytes of the full buffer that differ from `ref`, ignoring pixels inside the rectangle.
// Layout: 8 pages of 256 bytes; byte p*256+x, bit (y & 7) = pixel (x, p*8 + bit).
static uint32_t diffOutside(const uint8_t* a, const uint8_t* ref, int rx, int ry, int rw, int rh) {
    uint32_t n = 0;
    for (int page = 0; page < 8; ++page) {
        uint8_t row_mask = 0;  // bits of this page that lie inside the rectangle's rows
        for (int bit = 0; bit < 8; ++bit) {
            const int y = page * 8 + bit;
            if (y >= ry && y < ry + rh) row_mask |= static_cast<uint8_t>(1u << bit);
        }
        for (int x = 0; x < 256; ++x) {
            const uint8_t inside = (x >= rx && x < rx + rw) ? row_mask : 0;
            const uint8_t diff = (a[page * 256 + x] ^ ref[page * 256 + x]) & static_cast<uint8_t>(~inside);
            if (diff) n++;
        }
    }
    return n;
}

static void countSnapDiff(const Snap& a, const Snap& b, uint32_t& any, uint32_t* fields[7]) {
    bool m = false;
    if (a.font != b.font) { (*fields[0])++; m = true; }
    if (a.vref != b.vref) { (*fields[1])++; m = true; }
    if (a.draw_color != b.draw_color) { (*fields[2])++; m = true; }
    if (a.font_mode != b.font_mode) { (*fields[3])++; m = true; }
    if (a.bitmap_mode != b.bitmap_mode) { (*fields[4])++; m = true; }
    if (a.height_mode != b.height_mode) { (*fields[5])++; m = true; }
    if (a.clip_x0 != b.clip_x0 || a.clip_y0 != b.clip_y0 || a.clip_x1 != b.clip_x1 || a.clip_y1 != b.clip_y1) {
        (*fields[6])++; m = true;
    }
    if (m) any++;
}

static void runM3() {
    M3& m = s_m3;
    m.duration_ms = kPhaseM3Ms;
    m.bx = s_clock->get_x(); m.by = s_clock->get_y(); m.bw = s_clock->get_w(); m.bh = s_clock->get_h();

    // --- Step 1: Non-framework application state, then snapshot ---
    display.setFont(u8g2_font_6x10_tr);
    display.setFontPosBaseline();
    display.setFontRefHeightText();
    display.setFontMode(0);
    display.setDrawColor(1);
    const Snap before = takeSnap();
    uint32_t* fields[7] = {&m.mis_font, &m.mis_vref, &m.mis_draw_color, &m.mis_font_mode,
                           &m.mis_bitmap_mode, &m.mis_height_mode, &m.mis_clip};

    Serial.printf("U8G2GL-M3 watch enter bounds_x=%d bounds_y=%d bounds_w=%d bounds_h=%d "
                  "duration_ms=%lu repaint_every_ms=500 (only the clock box should update; "
                  "ticker and colon freeze)\n",
                  m.bx, m.by, m.bw, m.bh, (unsigned long)kPhaseM3Ms);
    Serial.flush();

    // --- Step 2: Busy-wait, repaint every 500 ms ---
    static uint8_t copy[kBufBytes];
    const uint32_t start = millis();
    uint32_t next = start + 500;
    while (millis() - start < kPhaseM3Ms) {
        if (static_cast<int32_t>(millis() - next) < 0) continue;  // busy-wait: no handler, no delay
        next += 500;
        ui_subject_clock_time.set(epochNow());
        const uint8_t* buf = display.getBufferPtr();
        memcpy(copy, buf, kBufBytes);
        const int64_t t0 = esp_timer_get_time();
        const bool ret = u8g2gl_repaint_object(display, *s_clock);
        const uint32_t us = static_cast<uint32_t>(esp_timer_get_time() - t0);
        m.repaints++;
        if (ret) m.true_returns++; else m.false_returns++;
        m.repaint_us_sum += us;
        if (us < m.repaint_us_min) m.repaint_us_min = us;
        if (us > m.repaint_us_max) m.repaint_us_max = us;
        countSnapDiff(before, takeSnap(), m.mis_any, fields);
        const uint32_t oob = diffOutside(buf, copy, m.bx, m.by, m.bw, m.bh);
        if (oob) { m.oob_change_calls++; m.oob_bytes_changed += oob; }
        if (memcmp(buf, copy, kBufBytes) != 0 && oob == 0) m.in_bounds_changed++;
        u8g2gl_partial_refresh(display, m.bx, m.by, m.bw, m.bh);  // caller's push
        memcpy(s_prev, buf, kBufBytes);
    }
    Serial.printf("U8G2GL-M3 watch exit repaints=%lu\n", (unsigned long)m.repaints);
    Serial.flush();

    // --- Step 3: Resume ui_handler(); the next frame must render ---
    // The application state is left as set above, so this also shows ui_handler() running
    // over a non-framework state and leaving it as found.
    const uint32_t r0 = millis();
    bool first = true;
    while (millis() - r0 < 1000) {
        feedClock(s_d);  // content counters of this stage are not reported
        int64_t t0, t1; bool changed;
        Phase scratch;
        timedCall(scratch, t0, t1, changed);
        m.resume_calls++;
        if (changed) m.resume_changed++;
        if (first) { m.resume_first_changed = changed ? 1 : 0; first = false; }
        if (scratch.sent) m.resume_sent++;
        uint32_t scratch_fields[7] = {0};
        uint32_t* sf[7] = {&scratch_fields[0], &scratch_fields[1], &scratch_fields[2], &scratch_fields[3],
                           &scratch_fields[4], &scratch_fields[5], &scratch_fields[6]};
        countSnapDiff(before, takeSnap(), m.resume_state_mis, sf);
        delay(10);
    }
}

// ---------------------------------------------------------------- reports

static void printPhase(const char* name, const Phase& p, bool is_d) {
    const double secs = p.duration_ms / 1000.0;
    Serial.printf("U8G2GL-M1 phase=%s summary duration_ms=%lu calls=%lu calls_per_s=%.1f "
                  "sent=%lu changed=%lu changed_per_s=%.2f wasted_sends=%lu\n",
                  name, (unsigned long)p.duration_ms, (unsigned long)p.calls, p.calls / secs,
                  (unsigned long)p.sent, (unsigned long)p.changed, p.changed / secs,
                  (unsigned long)p.wasted);
    Serial.printf("U8G2GL-M1 phase=%s call_us n_send=%lu mean_send_us=%lu min_send_us=%lu "
                  "max_send_us=%lu n_nosend=%lu mean_nosend_us=%lu max_nosend_us=%lu "
                  "send_threshold_us=%lu separated=%d\n",
                  name, (unsigned long)p.sent,
                  (unsigned long)(p.sent ? p.sum_send_us / p.sent : 0),
                  (unsigned long)(p.sent ? p.min_send_us : 0), (unsigned long)p.max_send_us,
                  (unsigned long)(p.calls - p.sent),
                  (unsigned long)((p.calls - p.sent) ? p.sum_nosend_us / (p.calls - p.sent) : 0),
                  (unsigned long)p.max_nosend_us, (unsigned long)kSendThresholdUs,
                  (p.sent == 0 || (p.max_nosend_us < kSendThresholdUs && p.min_send_us > kSendThresholdUs)) ? 1 : 0);
    Serial.printf("U8G2GL-M1 phase=%s deadline_hist_ms", name);
    for (int i = 0; i < kBuckets; ++i) Serial.printf(" %s=%lu", kBucketName[i], (unsigned long)p.hist[i]);
    Serial.println();
    Serial.printf("U8G2GL-M1 phase=%s scroll steps_1px=%lu wraps=%lu jumps_gt1px=%lu back=%lu "
                  "expected_steps_at_40pxps=%lu (after 1000 ms initial delay) colon_toggles=%lu "
                  "expected_colon_toggles=%lu\n",
                  name, (unsigned long)p.scroll_steps, (unsigned long)p.scroll_wraps,
                  (unsigned long)p.scroll_jumps, (unsigned long)p.scroll_back,
                  (unsigned long)((p.duration_ms - 1000) * 40 / 1000),
                  (unsigned long)p.colon_toggles, (unsigned long)(p.duration_ms / 500));
    Serial.printf("U8G2GL-M1 phase=%s clock subject_changes=%lu skipped_seconds=%lu "
                  "write_lateness_ms_mean=%lu write_lateness_ms_max=%lu (ms past the second at "
                  "the app's write, before the frame)\n",
                  name, (unsigned long)p.clock_changes, (unsigned long)p.clock_skips,
                  (unsigned long)(p.clock_lat_n ? p.clock_lat_sum_ms / p.clock_lat_n : 0),
                  (unsigned long)p.clock_lat_max_ms);
    if (is_d) {
        Serial.printf("U8G2GL-M1 phase=D deadline cap_ms=%lu cap_hits=%lu idle_returns=%lu\n",
                      (unsigned long)kDeadlineCapMs, (unsigned long)p.cap_hits,
                      (unsigned long)p.idle_returns);
        Serial.printf("U8G2GL-M1 phase=D wake_vs_promise_us early_gt1ms=%lu ontime_pm1ms=%lu "
                      "late_gt1ms=%lu (late_1_5ms=%lu late_5_10ms=%lu late_gt10ms=%lu) "
                      "max_late_us=%ld most_early_us=%ld\n",
                      (unsigned long)p.wake_early, (unsigned long)p.wake_ontime,
                      (unsigned long)p.wake_late, (unsigned long)p.late_1_5,
                      (unsigned long)p.late_5_10, (unsigned long)p.late_gt10,
                      (long)p.max_late_us, (long)p.min_early_us);
        Serial.printf("U8G2GL-M1 phase=D change_appear_after_promise_us n=%lu mean=%lu max=%lu "
                      "(promise to end of the call that drew it, frame time included)\n",
                      (unsigned long)p.appear_n,
                      (unsigned long)(p.appear_n ? p.sum_appear_us / p.appear_n : 0),
                      (unsigned long)p.max_appear_us);
        Serial.printf("U8G2GL-M1 phase=D woken_with_nothing_to_do calls_without_send_or_change=%lu\n",
                      (unsigned long)p.nochange_nosend);
    }
}

static void printM1() {
    Serial.printf("U8G2GL-M1 runtime=%s schema=0.4 generator=0.12.0 clock=esp_timer_get_time unit=us "
                  "buffer_bytes=%u\n", s_runtime_str, (unsigned)kBufBytes);
    printPhase("U", s_u, false);
    printPhase("D", s_d, true);
    Serial.println("U8G2GL-M1 end");
}

static void printM3() {
    const M3& m = s_m3;
    Serial.printf("U8G2GL-M3 bounds x=%d y=%d w=%d h=%d duration_ms=%lu repaint_every_ms=500\n",
                  m.bx, m.by, m.bw, m.bh, (unsigned long)m.duration_ms);
    Serial.printf("U8G2GL-M3 repaints=%lu true_returns=%lu false_returns=%lu repaint_us_min=%lu "
                  "repaint_us_mean=%lu repaint_us_max=%lu (repaint only, partial refresh excluded)\n",
                  (unsigned long)m.repaints, (unsigned long)m.true_returns,
                  (unsigned long)m.false_returns, (unsigned long)(m.repaints ? m.repaint_us_min : 0),
                  (unsigned long)(m.repaints ? m.repaint_us_sum / m.repaints : 0),
                  (unsigned long)m.repaint_us_max);
    Serial.printf("U8G2GL-M3 state_mismatch_calls=%lu of n=%lu by_field font=%lu font_pos=%lu "
                  "draw_color=%lu font_mode=%lu bitmap_mode=%lu height_mode=%lu clip_window=%lu "
                  "(clip window is not a state_saver field; reported for information)\n",
                  (unsigned long)m.mis_any, (unsigned long)m.repaints, (unsigned long)m.mis_font,
                  (unsigned long)m.mis_vref, (unsigned long)m.mis_draw_color,
                  (unsigned long)m.mis_font_mode, (unsigned long)m.mis_bitmap_mode,
                  (unsigned long)m.mis_height_mode, (unsigned long)m.mis_clip);
    Serial.printf("U8G2GL-M3 buffer_outside_bounds changed_calls=%lu of n=%lu changed_bytes=%lu "
                  "repaints_that_changed_only_inside=%lu\n",
                  (unsigned long)m.oob_change_calls, (unsigned long)m.repaints,
                  (unsigned long)m.oob_bytes_changed, (unsigned long)m.in_bounds_changed);
    Serial.printf("U8G2GL-M3 resume ui_handler calls=%lu first_call_changed_buffer=%lu "
                  "calls_with_change=%lu calls_with_send=%lu calls_state_mismatch=%lu (state "
                  "left at the app's M3 state)\n",
                  (unsigned long)m.resume_calls, (unsigned long)m.resume_first_changed,
                  (unsigned long)m.resume_changed, (unsigned long)m.resume_sent,
                  (unsigned long)m.resume_state_mis);
    Serial.println("U8G2GL-M3 end");
}

static uint32_t s_last_report_ms = 0;

void setup() {
    Serial.begin(115200);
    const uint32_t t = millis();
    while (!Serial && millis() - t < 3000) delay(10);
    delay(500);
    static char ver[16];
    snprintf(ver, sizeof(ver), "%d.%d.%d", U8G2GL_VERSION_MAJOR, U8G2GL_VERSION_MINOR, U8G2GL_VERSION_PATCH);
    s_runtime_str = ver;
    Serial.printf("U8G2GL-M1 boot env=m1 runtime=%s\n", ver);
    Serial.flush();

    SPI.begin(kPinSck, kPinMiso, kPinMosi, -1);
    display.begin();

    u8g2gl_set_tick_cb(tickNow);
    ui_init();
    s_ticker = static_cast<u8g2gl_label*>(ui_screen_measure.objs[0]);
    s_clock = static_cast<u8g2gl_clock*>(ui_screen_measure.objs[1]);
    s_last_epoch_written = epochNow();
    ui_subject_clock_time.set(s_last_epoch_written);
    u8g2gl_set_active_screen(&ui_screen_measure);

    // First frame, so the panel shows the screen and s_prev holds a real baseline.
    ui_handler(display);
    memcpy(s_prev, display.getBufferPtr(), kBufBytes);

    Serial.println("U8G2GL-M1 phase=U start duration_ms=20000 (uncapped ui_handler loop; ticker scrolls, colon blinks)");
    Serial.flush();
    runPhaseU();
    Serial.println("U8G2GL-M1 phase=D start duration_ms=20000 (delay(deadline); ticker, clock seconds and colon should run smoothly)");
    Serial.flush();
    runPhaseD();
    runM3();
    printM1();
    printM3();
    s_last_report_ms = millis();
}

void loop() {
    if (millis() - s_last_report_ms >= 5000) {
        s_last_report_ms = millis();
        printM1();
        printM3();
    }
    delay(20);
}
